/*
 * Device-tree overlay for the InvenSense/TDK ICM-45686 6-axis IMU on the
 * Raspberry Pi user-facing I2C bus (i2c-1, GPIO 2/3).
 *
 * Build:        dtc -@ -I dts -O dtb -o icm45686.dtbo icm45686-overlay.dts
 * Activate:     copy to /boot/firmware/overlays/ then add to /boot/firmware/config.txt:
 *                 dtoverlay=icm45686               # defaults to addr 0x68 (AP_AD0 = 0)
 *                 dtoverlay=icm45686,addr=0x69     # AP_AD0 pin tied high
 *
 * If your sensor is on a different I2C bus, change `target = <&i2c1>` below.
 *
 * INT1 data-ready interrupt is MANDATORY. The mainline driver calls
 * fwnode_irq_get_byname(.., "int1") and aborts probe with -EINVAL if it is
 * missing, so the chip's INT1 pin must be wired to a Pi GPIO and described
 * by all three of interrupt-parent / interrupts / interrupt-names below.
 * Default: GPIO17 + IRQ_TYPE_EDGE_RISING (= 1). Many boards wire active-low INT1;
 * if /proc/interrupts stays at 0 but buffered reads work, use
 *   dtoverlay=icm45686,int_trigger=8
 * (LEVEL_LOW, matches driver active-low INT1 while FIFO threshold is asserted).
 * Edge types (2=falling) can miss narrow or already-low lines. Open-drain INT:
 * add drive-open-drain on icm45686@68 plus a GPIO pull-up.
 */

/dts-v1/;
/plugin/;

/ {
	compatible = "brcm,bcm2835";

	fragment@0 {
		target = <&i2c1>;
		__overlay__ {
			#address-cells = <1>;
			#size-cells = <0>;
			status = "okay";

			icm45686: icm45686@68 {
				compatible = "invensense,icm45686";
				reg = <0x68>;
				status = "okay";
				/* mount-matrix = "1","0","0","0","1","0","0","0","1"; */

				/* INT1 data-ready, wired to BCM GPIO17 (header pin 11).
				 * interrupt-names = "int1" is required: the driver looks
				 * the IRQ up by name, not by index. */
				interrupt-parent = <&gpio>;
				interrupts = <17 1>;
				interrupt-names = "int1";
				/* Uncomment if INT1 is open-drain (needs GPIO pull-up):
				 * drive-open-drain;
				 */
			};
		};
	};

	__overrides__ {
		addr = <&icm45686>,"reg:0";
		/* First cell: BCM GPIO (default 17 = header pin 11). */
		int_gpio = <&icm45686>,"interrupts:0";
		/* Second cell: Linux irq type (1=rising, 2=falling, 4=level-high, 8=level-low). */
		int_trigger = <&icm45686>,"interrupts:4";
	};
};
